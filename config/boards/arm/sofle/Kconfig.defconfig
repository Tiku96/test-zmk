## config/boards/arm/sofle/nice_nano/Kconfig
```kconfig
menu "Backlight options"

config ZMK_BACKLIGHT
    bool "Enable backlight support"
    default y
    help
      Enables support for backlight using PWM.

config ZMK_DISPLAY_STANDBY
    bool "Enable display standby support"
    default n
    help
      Enables support for display standby.

config ZMK_LED_STANDBY
    bool "Enable LED standby support"
    default n
    help
      Enables support for LED standby.

endmenu
```
